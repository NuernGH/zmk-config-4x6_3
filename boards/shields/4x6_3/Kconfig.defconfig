## boards/shields/4x6_3/Kconfig.defconfig
```kconfig
# Copyright (c) 2021 The ZMK Contributors
# SPDX-License-Identifier: MIT

if SHIELD_4x6_3

config ZMK_KEYBOARD_NAME
    default "4x6_3"

endif
```
